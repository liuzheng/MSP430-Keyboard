/* --------------------------------------------------------------------------
* Copyright (c) 2012, IAR Systems - All rights reserved.
*
* This source code is the property of IAR Systems. The source code may only
* be used together with the IAR Embedded Workbench. Redistribution and use
* in source and binary forms, with or without modification, is permitted
* provided that the following conditions are met:
*
* - Redistributions of source code, in whole or in part, must retain the
* above copyright notice, this list of conditions and the disclaimer below.
*
* - IAR SystemsТ name may not be used to endorse or promote products
* derived from this software without specific prior written permission.
*
* THE SOFTWARE IS PROVIDED "AS IS" AND THE AUTHOR DISCLAIMS ALL WARRANTIES
* WITH REGARD TO THIS SOFTWARE INCLUDING ALL IMPLIED WARRANTIES OF
* MERCHANTABILITY AND FITNESS. IN NO EVENT SHALL THE AUTHOR BE LIABLE FOR
* ANY SPECIAL, DIRECT, INDIRECT, OR CONSEQUENTIAL DAMAGES OR ANY DAMAGES
* WHATSOEVER RESULTING FROM LOSS OF USE, DATA OR PROFITS, WHETHER IN AN
* ACTION OF CONTRACT, NEGLIGENCE OR OTHER TORTIOUS ACTION, ARISING OUT OF
* OR IN CONNECTION WITH THE USE OR PERFORMANCE OF THIS SOFTWARE.
* ------------------------------------------------------------------------*/
//*****************************************************************
//
// XLINK linker file for IAR Embedded Workbench for MSP430.
//
// This file describes the Flash and RAM memory locations for USB Keyboard
//*****************************************************************

/* Memory Map - MSP430F5510
 *  Peripheral units:               0-01FF
 *
 * Info memory :                    1800 - 19FF
 *
 * RAM:                             2400 - 33FF
 *  USBKBD_RAM                      2400 - 31FF
 *  USBKBD_STACK                    3200 - 33FF
 *
 * FLASH:                           8000 - FF7F
 *  USBKBD_Code                     8000 - F9FF
 *  USBKBD_ScanCodes                FA00 - FBFF
 *  USBKBD_ConfigConst              FC00 - FDFF
 *  IntVectors                      FF80 - FFFF
 */

/*
 *  Define Memory locatios here
 */
// RAM
-D_USBKBD_RAM_Start=2400
-D_USBKBD_RAM_End=31FF
-D_USBKBD_Stack_Start=3200
-D_USBKBD_Stack_End=33FF


// Flash
-D_USBKBD_Code_Start=8000
-D_USBKBD_Code_End=F9FF
-D_USBKBD_ScanCodes_Start=FA00
-D_USBKBD_ScanCodes_End=FBFF
-D_USBKBD_ConfigConst_Start=FC00
-D_USBKBD_ConfigConst_End=FDFF

// Interrupt vectors
-D_IntVectors_Start=FF80
-D_IntVectors_Reset=FFFE
-D_IntVectors_End=FFFF


/*
 * Stack and heap
 */
-D_STACK_SIZE=0xC0
-D_DATA16_HEAP_SIZE=0x40


/*
 * Define CPU
 */
-cmsp430

/*
 * Support for placing functions in read/write memory
 */
-QCODE_I=CODE_ID

/*
 * RAM Placement
 */
-Z(DATA)USBKBD_RAM=_USBKBD_RAM_Start-_USBKBD_RAM_End
-Z(DATA)DATA16_I,DATA16_Z,DATA16_N,DATA16_HEAP+_DATA16_HEAP_SIZE=_USBKBD_RAM_Start-_USBKBD_Stack_End
-Z(DATA)CODE_I
-Z(DATA)CSTACK+_STACK_SIZE#


/*
 * INFO Memory Placement
 */
-Z(CONST)INFO=1800-19FF
-Z(CONST)INFOA=1980-19FF
-Z(CONST)INFOB=1900-197F
-Z(CONST)INFOC=1880-18FF
-Z(CONST)INFOD=1800-187F


/*
 * Constants placement (Flash)
 */
-Z(CONST)USBKBD_ScanCodes=_USBKBD_ScanCodes_Start-_USBKBD_ScanCodes_End
-Z(CONST)USBKBD_ConfigConst=_USBKBD_ConfigConst_Start-_USBKBD_ConfigConst_End
-Z(CONST)DATA16_C,DATA16_ID,DIFUNCT,CHECKSUM=_USBKBD_Code_Start-_USBKBD_Code_End


/*
 * Code Placement (Flash)
 */
-Z(CODE)USBKBD_Code=_USBKBD_Code_Start-_USBKBD_Code_End
-Z(CODE)CSTART,ISR_CODE,CODE_ID=_USBKBD_Code_Start-_USBKBD_Code_End
-P(CODE)CODE=_USBKBD_Code_Start-_USBKBD_Code_End


/*
 * Interrupt vectors placement
 */
-Z(CODE)INTVEC=_IntVectors_Start-_IntVectors_End
-Z(CODE)RESET=_IntVectors_Reset-_IntVectors_End
